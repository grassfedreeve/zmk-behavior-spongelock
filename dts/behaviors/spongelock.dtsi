/*
 * Copyright (c) 2024 The ZMK Contributors
 *
 * SPDX-License-Identifier: MIT
 */

#include <dt-bindings/zmk/keys.h>

/ {
	behaviors {
		/omit-if-no-ref/ spongelock: behavior_spongelock {
			compatible = "zmk,behavior-spongelock";
			label = "SPONGELOCK";
			#binding-cells = <0>;
		};
	};
};
