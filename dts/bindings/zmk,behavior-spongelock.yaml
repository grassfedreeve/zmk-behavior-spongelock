## dts/bindings/zmk,behavior-spongelock.yaml
```yaml
# Copyright (c) 2024 The ZMK Contributors
# SPDX-License-Identifier: MIT

description: SpOnGeLoCk BeHaViOr

compatible: "zmk,behavior-spongelock"

include: zero_param.yaml
```
